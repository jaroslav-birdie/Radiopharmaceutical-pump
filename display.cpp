#include "display.h"
#include <Wire.h>

// Standardní font 5x7 px, ASCII 0x20-0x7E, 5 bajtů na znak (sloupce).
static const uint8_t FONT5X7[] PROGMEM = {
    0x00,0x00,0x00,0x00,0x00, 0x00,0x00,0x5F,0x00,0x00, 0x00,0x07,0x00,0x07,0x00,
    0x14,0x7F,0x14,0x7F,0x14, 0x24,0x2A,0x7F,0x2A,0x12, 0x23,0x13,0x08,0x64,0x62,
    0x36,0x49,0x55,0x22,0x50, 0x00,0x05,0x03,0x00,0x00, 0x00,0x1C,0x22,0x41,0x00,
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    0x00,0x41,0x36,0x08,0x00, 0x10,0x08,0x08,0x10,0x08
};

// Řadič je SH1106 (NE SSD1306!) - o 2 sloupce širší interní RAM (132 px),
// viditelných je jen prostředních 128, proto OLED_COL_OFFSET. SH1106 navíc
// vůbec NEZNÁ příkazy 0x20 (Memory Addressing Mode) ani 0x21/0x22 (Set
// Column/Page Address range) - to jsou příkazy jen pro SSD1306. Adresování
// je vždy jen po stránkách (0xB0-0xB7 = vyber stránku) + dvě sloupcové
// "nibble" instrukce (0x00-0x0F dolní, 0x10-0x1F horní). Nábojová pumpa se
// navíc povoluje příkazem 0xAD (SSD1306 má pro totéž 0x8D).
void PumpDisplay::begin() {
    delay(100);                          // čas na ustálení napájení/charge pumpy displeje
    Wire.beginTransmission(OLED_ADDR);
    present_ = (Wire.endTransmission() == 0);
    if (!present_) {
        return;
    }
    static const uint8_t INIT_SEQ[] PROGMEM = {
        0xAE, 0xD5, 0x80, 0xA8, 0x3F, 0xD3, 0x00, 0x40, 0xAD, 0x8B,
        0xA1, 0xC8, 0xDA, 0x12, 0x81, 0xCF, 0xD9, 0xF1,
        0xDB, 0x40, 0xA4, 0xA6, 0xAF
    };
    Wire.beginTransmission(OLED_ADDR);
    Wire.write((uint8_t)0x00);           // řídicí bajt: příkaz (platí pro celou transakci)
    for (uint8_t i = 0; i < sizeof(INIT_SEQ); i++) {
        Wire.write(pgm_read_byte(&INIT_SEQ[i]));
    }
    Wire.endTransmission();
    clear();
}

// Vybere stránku (0xB0-0xB7) a nastaví počáteční sloupec přes dvě
// jednobajtové "nibble" instrukce (SH1106 nemá rozsahový příkaz 0x21).
void PumpDisplay::setWindow(uint8_t row) {
    uint8_t colLow  = 0x00 | (OLED_COL_OFFSET & 0x0F);
    uint8_t colHigh = 0x10 | (OLED_COL_OFFSET >> 4);
    Wire.beginTransmission(OLED_ADDR);
    Wire.write((uint8_t)0x00);
    Wire.write((uint8_t)(0xB0 | row));   // vyber stránku (page)
    Wire.write(colLow);
    Wire.write(colHigh);
    Wire.endTransmission();
}

void PumpDisplay::clear() {
    if (!present_) {
        return;
    }
    for (uint8_t row = 0; row < 8; row++) {
        drawRow(row, "");
    }
}

// Vykreslí text na řádek: 21 znaků po 6 px (5 px font + 1 px mezera).
// Data se posílají po 16 B kvůli 32B bufferu knihovny Wire.
void PumpDisplay::drawRow(uint8_t row, const char *text) {
    if (!present_ || row > 7) {
        return;
    }
    setWindow(row);
    uint8_t col = 0;                     // celkem vždy odešleme 128 sloupců
    uint8_t ti = 0;
    while (col < 128) {
        Wire.beginTransmission(OLED_ADDR);
        Wire.write((uint8_t)0x40);       // řídicí bajt: data
        for (uint8_t b = 0; b < 16 && col < 128; b++) {
            char c = text[ti];
            uint8_t sub = col % 6;
            uint8_t px = 0;
            if (c != '\0' && sub < 5) {
                uint8_t idx = (c < 0x20 || c > 0x7E) ? 0 : (c - 0x20);
                px = pgm_read_byte(&FONT5X7[idx * 5 + sub]);
            }
            Wire.write(px);
            col++;
            if (sub == 5 && c != '\0') {
                ti++;                    // za mezerou mezi znaky další znak
            }
        }
        Wire.endTransmission();
    }
}
